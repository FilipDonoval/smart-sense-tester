## components/mqtt_handler/Kconfig
```kconfig
menu "MQTT handler configuration"
    config MQTT_BROKER_URI
        string "Broker uri"
        default "myuri"
        help
            Uri of MQTT broker

    config MQTT_BROKER_USERNAME
        string "Username"
        default "myusername"
        help
            Username for connecting to MQTT broker

    config MQTT_BROKER_PASSWORD
        string "Password"
        default "mypassword"
        help
            Password for connecting to MQTT broker

endmenu
```

## components/wifi_sta/Kconfig
```kconfig
menu "WiFi STA configuration"
    config WIFI_STA_SSID
        string "WiFi SSID"
        default "myssid"
        help
            Network name (SSID) to connect to

    config WIFI_STA_PASSWORD
        string "WiFi password"
        default "mypassword"

    config MAX_RECONNECT_TRY
        int "Maximum reconnect tries"
        default 5

    choice WIFI_STA_AUTH_MODE
        prompt "Minimum WiFi authentication mode"
        default WIFI_STA_AUTH_WPA2_PSK
        help
            The weakest authentication mode that the device will attempt to
            use when connecting to an access point.
        config WIFI_STA_AUTH_OPEN
            bool "OPEN"
        config WIFI_STA_AUTH_WEP
            bool "WEP"
        config WIFI_STA_AUTH_WPA_PSK
            bool "WPA PSK"
        config WIFI_STA_AUTH_WPA2_PSK
            bool "WPA2 PSK"
        config WIFI_STA_AUTH_WPA_WPA2_PSK
            bool "WPA/WPA2 PSK"
        config WIFI_STA_AUTH_WPA3_PSK
            bool "WPA3 PSK"
        config WIFI_STA_AUTH_WPA2_WPA3_PSK
            bool "WPA2/WPA3 PSK"
        config WIFI_STA_AUTH_WAPI_PSK
            bool "WAPI PSK"
    endchoice

    choice WIFI_STA_WPA3_SAE_MODE
        prompt "SAE mode for WPA3"
        default WIFI_STA_WPA3_SAE_PWE_BOTH
        help
            Select SAE mode as Hunt and Peck, H2E, or both.
        config WIFI_STA_WPA3_SAE_PWE_HUNT_AND_PECK
            bool "Hunt and Peck"
        config WIFI_STA_WPA3_SAE_PWE_H2E
            bool "Hash to Element (H2E)"
        config WIFI_STA_WPA3_SAE_PWE_BOTH
            bool "Both"
    endchoice

    config WIFI_STA_WPA3_PASSWORD_ID
        string "Password identifier for SAE H2E"
        depends on WIFI_STA_WPA3_SAE_PWE_H2E || WIFI_STA_WPA3_SAE_PWE_BOTH
        default ""
        help
            Password identifier for SAE H2E mode.

    config WIFI_STA_AUTO_RECONNECT
        bool "Automatically attempt reconnect on disconnect"
        default n
        help
            If a disconnect event occurs, automatically attempt to reconnect to
            the network.
endmenu
```
